/*
 * Copyright (c) 2015-2016, The Linux Foundation. All rights reserved.
 *
 * This program is free software; you can redistribute it and/or modify
 * it under the terms of the GNU General Public License version 2 and
 * only version 2 as published by the Free Software Foundation.
 *
 * This program is distributed in the hope that it will be useful,
 * but WITHOUT ANY WARRANTY; without even the implied warranty of
 * MERCHANTABILITY or FITNESS FOR A PARTICULAR PURPOSE.  See the
 * GNU General Public License for more details.
 */

&soc {
	vfe0: qcom,vfe0@1b10000 {
		reg = <0x1b10000 0x1000>,
			<0x1b40000 0x200>,
			<0x00a4174 0x8>;
		reg-names = "vfe", "vfe_vbif", "vfe_fuse";
	};

	vfe1: qcom,vfe1@1b14000 {
		reg = <0x1b14000 0x1000>,
			<0x1ba0000 0x200>,
			<0x00a4174 0x8>;
		reg-names = "vfe", "vfe_vbif", "vfe_fuse";
	};
};

